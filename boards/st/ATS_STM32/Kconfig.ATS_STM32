## boards/st/ATS_STM32/Kconfig.ATS_STM32
```kconfig
# Copyright (c) 2026 VT FSAE
# SPDX-License-Identifier: Apache-2.0

# modified by Luke Tighe 3-15-2026

config BOARD_ATS_STM32
	select SOC_STM32H753XX
```

## boards/st/ATS_STM32/Kconfig.defconfig
```kconfig
# Copyright (c) 2026 VT FSAE
# SPDX-License-Identifier: Apache-2.0

# Modified by Luke Tighe 3-15-26

if BOARD_ATS_STM32

config BOARD
	default "ATS_STM32"

endif # BOARD_ATS_STM32
```

## boards/st/ATS_STM32/board.yml
```yaml
# Modified by Luke Tighe 3-15-2026

board:
  name: ATS_STM32
  full_name: ATS_STM32H753VIT6
  vendor: Custom
  socs:
    - name: stm32h753xx
```

## boards/st/vcu_stm32/board.yml
```yaml
board:
  name: vcu_stm32
  full_name: VCU_STM32H753VIT6
  vendor: st
  socs:
    - name: stm32h753xx
```
